## package/python-asyncio-mqtt/Config.in
```kconfig
config BR2_PACKAGE_PYTHON_ASYNCIO_MQTT
    bool "python-asyncio-mqtt"
    select BR2_PACKAGE_PYTHON_PAHO_MQTT # runtime
    select BR2_PACKAGE_PYTHON_SETUPTOOLS_SCM
    help
      The idiomatic asyncio MQTT client, wrapped around paho-mqtt

      https://github.com/sbtinstruments/asyncio-mqtt
```

## package/python-macaddress/Config.in
```kconfig
config BR2_PACKAGE_PYTHON_MACADDRESS
	bool "python-macaddress"
	help
	  Like ``ipaddress``, but for hardware identifiers such as
	  MAC addresses.

	  https://github.com/mentalisttraceur/python-macaddress
```

## package/python-schema/Config.in
```kconfig
config BR2_PACKAGE_PYTHON_SCHEMA
	bool "python-schema"
	select BR2_PACKAGE_PYTHON_CONTEXTLIB2 # runtime
	help
	  Simple data validation library.

	  https://github.com/keleshev/schema
```
